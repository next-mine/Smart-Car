/*********************************************************************************************************************
* RT1064DVL6A 电磁循迹 —— 环岛识别与通过
*
* 版本修改记录
* 日期              修改人                备注
* 2026-10-21        ----                  first version：先外后内识别 + 三段式打角
*
* 这个文件只干两件事，别的都不掺和：
*   1) 看四路电感，判断"车头是不是正对着一个环岛入口"，判断出来就推进状态机；
*   2) 在环岛的几个阶段里，替舵机做决定（给一个固定角度 / 固定角度 + 偏差补偿）。
* 速度那边只是对外提供一个"环岛期间不许超过多少"的上限，具体怎么用是 speed_control.c 的事。
********************************************************************************************************************/

#include "zf_common_headfile.h"
#include "my_common.h"
#include "get_data.h"
#include "roundabout.h"

// 注意：这里**不包含** servo_control.h。
// 环岛段的舵机折算是自己算的（RB_KP / RB_KD / RB_DELTA_*），不借用主循迹的 kp / kd，
// 也不碰 servo_motor_angle —— 只通过 roundabout_servo_takeover() 把目标角度交出去。
// 少一条包含，就少一条"调主循迹参数顺带改了环岛"的隐蔽通道。

//-------------------------------------------------------------------------------------------------------------------
// 对外状态量
//-------------------------------------------------------------------------------------------------------------------
roundabout_state_enum rb_state = RB_STATE_IDLE;    // 当前阶段，屏幕 RB 那一位
uint8  rb_reason = 0;                              // 上一次"放弃"的原因，屏幕 X 那一位
uint16 rb_tick   = 0;                              // 当前阶段已经走了几个 10ms 周期，屏幕最右边
int16  rb_total  = 0;                              // 四路归一化之和 0~400（目前没上屏，留着备用）
uint16 rb_dbg_dur  = 0;                            // 上一次识别从候选到打角一共花了多少拍（屏幕第 0 行）
uint8  rb_dbg_ch   = 0;                            // 上一次识别里"涨得最猛"的是哪一路，屏幕第 0 行
int16  rb_dbg_rise = 0;                            // 那一路涨了多少（峰值 - 起点），屏幕第 0 行
int16  rb_dbg_peak = 0;                            // 那一路的峰值；屏幕第 0 行

//-------------------------------------------------------------------------------------------------------------------
// 内部状态
//-------------------------------------------------------------------------------------------------------------------
// 这里不需要"直道基线"之类的自适应量了：识别靠的是内侧电感的"隆起 → 落回个位数"这个包络，
// 是一个**形状**判据，不是"某个值超过多少"的绝对判据，所以换车、调探头高度都不会失效。
// 唯一还需要手调的是几个阈值，都在 my_common.h 第 ⑦ 段，并且注释里写了怎么标。

// 外侧"掉下去"的连续计数：外侧偶尔掉一拍是正常的（岔路那根线扫过去的时候就是这样），
// 连续掉够 RB_OUTER_WEAK_TICKS 拍才算真的没了。没有这个去抖，驼峰中途会被误判成假警报。
static uint16 rb_weak_tick = 0;

// 越过触发线之后的倒数：>0 表示"已经跌破比例线了"，正在等 RB_ENTER_DELAY_TICKS 拍。
// 用这个而不是直接从比例线跳到 ENTER，是为了有一格 10ms 的线性旋钮可以精调时机。
static uint16 rb_fall_tick = 0;

// 环岛段自己的偏差记忆（给 RB_KD 那一项用的）。
// 刻意不复用主循迹的 last_adc_error：那一个在接管期间会被同步成当前值，
// 拿它算微分永远是 0，等于把 D 项废掉；而且共用也会让两个场景互相牵制。
static float rb_last_error = 0.0f;

// 驼峰跟踪：WAIT 开始时先把三路（除最外侧那一路上）的值记成"起点"，
// 之后每拍更新峰值。哪一路"从起点涨够了、并且峰值够高"，哪一路就是驼峰。
// 为什么不写死 n[1]：实测这台车的 n[1] 全程没超过 20，说明驼峰根本不在那路上，
// 写死一路等于把识别钉死在一个不成立的前提上。
static int16 rb_hump_start[ADC_CHANNEL_NUMBER];
static int16 rb_hump_peak [ADC_CHANNEL_NUMBER];
static uint8 rb_hump_ch = 0;                        // 正在跟的那一路驼峰，0 = 还没找到

static uint8 rb_detect (void);
static uint8 rb_scan_hump (void);
static void  rb_back_to_idle (void);

//-------------------------------------------------------------------------------------------------------------------
// @brief   环岛模块上电初始化
// @param   无
// @retval  无
// @note    必须在第一次进中断之前调用一次。它只把状态机、计时器拉回出厂状态，
//          不碰任何硬件寄存器 —— 环岛本身不需要额外外设，全部靠已有的四路电感。
//-------------------------------------------------------------------------------------------------------------------
void roundabout_init (void)
{
    uint8 ch;

    rb_state     = RB_STATE_IDLE;
    rb_reason    = 0;
    rb_tick      = 0;
    rb_total     = 0;
    rb_weak_tick = 0;
    rb_fall_tick = 0;
    rb_hump_ch   = 0;
    rb_dbg_ch    = 0;
    rb_dbg_rise  = 0;
    rb_dbg_peak  = 0;
    rb_dbg_dur   = 0;
    rb_last_error = 0.0f;

    for (ch = 0; ch < ADC_CHANNEL_NUMBER; ch ++)
    {
        rb_hump_start[ch] = 0;
        rb_hump_peak [ch] = 0;
    }
}

//-------------------------------------------------------------------------------------------------------------------
// @brief   把状态机整体复位回"正常循迹"
// @param   无
// @retval  无
// @note    退出环岛、假警报、安全阀超时，三种情况都走这一个出口，
//          免得三处各写一遍"清哪些变量"，以后改一个地方漏了另外两个就很难查。
//          注意这里**不清 rb_reason**：那是"上一次为什么放弃"的记录，
//          要在跑完之后还能从屏幕上看，所以只有新的一次识别开始时才清零。
//-------------------------------------------------------------------------------------------------------------------
static void rb_back_to_idle (void)
{
    rb_state     = RB_STATE_IDLE;
    rb_tick      = 0;
    rb_weak_tick = 0;
    rb_fall_tick = 0;
}

//-------------------------------------------------------------------------------------------------------------------
// @brief   判断"左外侧先饱和、左内侧还没跟上"这个环岛入口特征
// @param   无
// @retval  uint8   1 = 命中左环岛入口；0 = 没命中
// @note    本版本只处理"向左进环岛"，所以这里只有左环岛一条分支，没有镜像的右环岛版本。
//          判到了也只是进 WAIT，还不会动舵机。三个条件：
//            ① n[0] >= RB_OUTER_TH：这一路被岔路那根线顶到快满了（实测 70 -> 100）；
//            ② n[0] - n[1] >= RB_OUTER_GAP：说明是**外侧先**站起来，不是内外一起涨。
//               普通弯道是内外一起涨的，这一条能把绝大多数弯道挡在外面。
//            ③ n[0] - n[3] >= RB_OUTER_ASYM：**单侧性**，见下面的说明，专治十字路口。
//
//          ★ 为什么要第 ③ 条（十字路口误判的教训）：
//          十字路口也"多出一根线"，①② 它全都满足，于是整台环岛状态机被完整跑了一遍
//          （WAIT->HUMP->ENTER->LOOP->EXIT->COOL），车被强制左打了将近 3 秒 ——
//          表现就是"过了十字路口、该右转的地方却往左拐"，而那时屏幕上的 RB 已经走到 6（冷却）。
//          区别在于：十字路口那根线是**横穿**赛道的，左右两侧会被同时顶起来；
//          环岛的岔口线只在一侧。所以要求"近侧外沿明显高于对侧外沿"，
//          对称的十字路口（n[0] ≈ n[3]，差值接近 0）就会被直接挡掉。
//          再加上一个前置条件"没丢线"：丢线时四路归一化全是 0，拿这种数据去凑阈值只会造假警报。
//          真正的"确认是环岛"不在这里判，交给后面的 WAIT->HUMP，靠内侧隆起来证明。
//-------------------------------------------------------------------------------------------------------------------
static uint8 rb_detect (void)
{
    // 丢线的时候四路都是 0，没必要往下凑阈值
    if (0 != line_lost_flag)
    {
        return 0;
    }

    // 注意这里要先转 int16 再相减：两个 int16 相减会先整型提升成 int，
    // 差值最多 ±100，其实不提也行，但写出来意图更清楚，也不会被以后改类型坑到。
    if ((adc_normal[0] >= RB_OUTER_TH) &&
        ((int16)(adc_normal[0] - adc_normal[1]) >= RB_OUTER_GAP) &&
        ((int16)(adc_normal[0] - adc_normal[3]) >= RB_OUTER_ASYM))
    {
        return 1;
    }

    return 0;
}

//-------------------------------------------------------------------------------------------------------------------
// @brief   在三条"非最外侧"的通道里找出驼峰，并顺手更新诊断信息
// @param   无
// @retval  uint8   0 = 还没有哪一路涨够；1~3 = 这一路的驼峰成立了
// @note    判据是"**从这个阶段的起点涨起来**，而且峰值够高"，两个条件缺一不可：
//            ① 峰值 - 起点 >= RB_INNER_RISE：说明它是"鼓"起来的，不是本来就待在高位。
//               普通弯道上内侧起点就高，涨不出这个差值，所以不会被当成驼峰；
//            ② 峰值 >= RB_INNER_TH：鼓起来的绝对值也要够，别把噪声当驼峰。
//          多路同时满足时取"涨得最猛"的那一路，HUMP 阶段就盯它。
//          顺带更新 rb_dbg_ch / rb_dbg_peak：不管这次成没成，屏幕上都会留下
//          "哪一路鼓得最猛、鼓到多高"，这就是下一轮标阈值最直接的依据。
//-------------------------------------------------------------------------------------------------------------------
static uint8 rb_scan_hump (void)
{
    uint8 ch;
    uint8 best = 0;
    int16 rise;
    int16 best_rise = 0;

    // 驼峰只在**下标 1、2** 这两路里找，两头都不参与：
    //   下标 0 = 外侧，它正在饱和，本来就是触发条件，不可能是"驼峰"；
    //   下标 3 = **对侧外沿**。实测十字路口那次驼峰正好落在它上面（峰值 47），
    //            而环岛的驼峰落在下标 1。物理上也说得通：
    //            环岛是**单侧**岔路，对侧外沿不该被鼓起来；
    //            十字路口的横穿线是左右同时扫过去的，连远侧外沿都被顶到 47。
    //            所以把下标 3 排除，就把"十字路口"这一类挡掉了一大半。
    for (ch = 1; ch < (ADC_CHANNEL_NUMBER - 1); ch ++)
    {
        rise = (int16)(rb_hump_peak[ch] - rb_hump_start[ch]);

        if (rise > best_rise)
        {
            best_rise = rise;
            best      = ch;
        }
    }

    rb_dbg_ch   = best;
    rb_dbg_rise = best_rise;
    rb_dbg_peak = (0 != best) ? rb_hump_peak[best] : 0;

    if ((0 != best) && (best_rise >= RB_INNER_RISE) && (rb_hump_peak[best] >= RB_INNER_TH))
    {
        return best;
    }

    return 0;
}

//-------------------------------------------------------------------------------------------------------------------
// @brief   环岛状态机主循环，每 10ms 调一次
// @param   无
// @retval  无
// @note    调用位置很关键：必须放在 get_data() 里 get_adc() 之后、set_servo_pwm() 之前。
//          因为它要用到本拍的 adc_normal / adc_error / line_lost_flag，
//          而它的结果又要赶在本拍舵机动作之前生效。
//          状态迁移：
//            IDLE -> WAIT -> HUMP -> ENTER -> LOOP -> EXIT -> COOL -> IDLE
//          前三个状态（WAIT/HUMP）只是在"读秒"，车照常按差比和走；
//          ENTER/LOOP/EXIT 才接管舵机；COOL 期间不识别。
//          各段时长都在 my_common.h 第 ⑦ 段，上车按屏幕上的计数一个一个试就行。
//-------------------------------------------------------------------------------------------------------------------
void roundabout_process (void)
{
    uint8 ch;

    // ---- 每拍先把"四路之和"算出来 ----
    // 现在它只用来上屏（T 那一位），识别本身已经不用它了 ——
    // 但调阈值的时候它仍然有用：信号整体偏弱（车被抬起来、电池掉了）一眼就能看出来。
    rb_total = (int16)(adc_normal[0] + adc_normal[1] + adc_normal[2] + adc_normal[3]);

    if (0 == RB_ENABLE)
    {
        // 总开关关掉的时候，状态机就当它不存在，屏幕上一直是 RB:0
        rb_back_to_idle();
        return;
    }

    // ---- 阶段计时 ----
    // 统一在这里加，省得每个 case 各写一遍；IDLE 不参与计时。
    if (RB_STATE_IDLE != rb_state)
    {
        rb_tick ++;

        // 识别耗时累计：只在 WAIT / HUMP 这两个"还在认"的阶段里加。
        // 它的用处是区分两种包络：环岛那种窄而快的（实测 18 拍），
        // 和十字路口那种宽而慢的（实测 46 拍）。
        if ((RB_STATE_WAIT == rb_state) || (RB_STATE_HUMP == rb_state))
        {
            rb_dbg_dur ++;

            // 认得太久 = 多半不是环岛。真实环岛 18 拍左右，上限给到 35 有接近 2 倍余量；
            // 十字路口那 46 拍的包络会被这里砍掉，不再往下走到 ENTER。
            // 放弃原因记成 5，屏幕 X 会显示，方便确认是不是这道判据拦下的。
            if (rb_dbg_dur > RB_DETECT_MAX_TICKS)
            {
                rb_reason = RB_REASON_DETECT_TIMEOUT;
                rb_back_to_idle();
                return;
            }
        }

        // 安全阀：万一某一段的时长填错了（比如多打了一个 0），
        // 没有这个保护车就会一直保持打角冲出去。到了上限一律放弃，交回正常循迹。
        if (rb_tick > RB_TICKS_MAX)
        {
            rb_reason = RB_REASON_TICK_MAX;
            rb_back_to_idle();
            return;
        }
    }

    switch (rb_state)
    {
        //-----------------------------------------------------------------------------------------------
        // 正常循迹：眼睛一直盯着"左外侧先饱和"这个入口特征
        //-----------------------------------------------------------------------------------------------
        case RB_STATE_IDLE:
        {
            if (0 != rb_detect())
            {
                // 只是"像"，先别急着打角，进 WAIT 等某一路鼓出驼峰来。
                // 这一段车还是按正常差比和走的，但已经不许往右打舵了（见 roundabout_forbid_right）。
                rb_reason    = RB_REASON_NONE;          // 新一轮识别开始，清掉上一次的放弃原因
                rb_tick      = 0;
                rb_weak_tick = 0;
                rb_fall_tick = 0;
                rb_hump_ch   = 0;
                rb_dbg_ch    = 0;
                rb_dbg_peak  = 0;
                rb_dbg_dur   = 0;

                // 把这一刻四路的读数记成驼峰的"起点"：后面只认"从这里涨起来"的。
                // 本来就待在 70 一路平推的不算驼峰，这样普通弯道就不会被误判成岔口。
                for (ch = 0; ch < ADC_CHANNEL_NUMBER; ch ++)
                {
                    rb_hump_start[ch] = adc_normal[ch];
                    rb_hump_peak [ch] = adc_normal[ch];
                }

                rb_state = RB_STATE_WAIT;
            }
        }break;

        //-----------------------------------------------------------------------------------------------
        // 等内侧隆起：确认这不是急弯，是岔口
        //-----------------------------------------------------------------------------------------------
        case RB_STATE_WAIT:
        {
            // 外侧去抖：岔路那根线扫过去的时候，外侧掉一两拍是正常的，
            // 连续掉够 RB_OUTER_WEAK_TICKS 拍才算"真的没了"。没有这一层，
            // 驼峰走到一半就会被误判成假警报，状态机半路撤退，交界处就没人管舵机了。
            if (adc_normal[0] < RB_OUTER_WEAK)
            {
                rb_weak_tick ++;
            }
            else
            {
                rb_weak_tick = 0;
            }

            // 每拍把下标 1、2 这两路的峰值记下来，再看哪一路"涨够了"
            // （下标 0 是饱和的外侧、下标 3 是对侧外沿，都不参与，理由见 rb_scan_hump）
            for (ch = 1; ch < (ADC_CHANNEL_NUMBER - 1); ch ++)
            {
                if (adc_normal[ch] > rb_hump_peak[ch])
                {
                    rb_hump_peak[ch] = adc_normal[ch];
                }
            }

            rb_hump_ch = rb_scan_hump();

            if (0 != rb_hump_ch)
            {
                // 某一路涨起来了 = 确认是岔口，开始盯它什么时候落回去
                rb_state     = RB_STATE_HUMP;
                rb_tick      = 0;
                rb_weak_tick = 0;
            }
            else if (rb_tick > RB_WAIT_TICKS)
            {
                rb_reason = RB_REASON_WAIT_TIMEOUT;     // 等太久，三路都没涨起来
                rb_back_to_idle();
            }
            else if (rb_weak_tick >= RB_OUTER_WEAK_TICKS)
            {
                rb_reason = RB_REASON_OUTER_LOST;       // 外侧自己没了，刚才那是抖动
                rb_back_to_idle();
            }
        }break;

        //-----------------------------------------------------------------------------------------------
        // 驼峰开始回落：跌到峰值的 RB_FALL_RATIO 倍就接管舵机
        // 这个比例就是"进环岛早还是晚"的总闸门，调它比调打角幅度更直接影响进弯时机
        //-----------------------------------------------------------------------------------------------
        case RB_STATE_HUMP:
        {
            // 驼峰可能比刚进 HUMP 时还高，继续跟住峰值，别让比例算在过时的峰值上
            if (adc_normal[rb_hump_ch] > rb_hump_peak[rb_hump_ch])
            {
                rb_hump_peak[rb_hump_ch] = adc_normal[rb_hump_ch];
            }

            // ★ 按比例而不是按固定值：
            //   实测峰值每次都不一样（23~44，随车速/车高/电池电压变），
            //   用固定阈值会让"峰值大的那次提前、峰值小的那次拖后"，同一个环岛每次进的时机都不同。
            //   按峰值比例就统一了：不管鼓多高，都是"回落掉 (1-比例) 那一刻"开始倒数。
            if ((0 != rb_fall_tick) ||
                ((float)adc_normal[rb_hump_ch] <= ((float)rb_hump_peak[rb_hump_ch] * RB_FALL_RATIO)))
            {
                rb_fall_tick ++;

                // 已经跌破比例线，再等满 RB_ENTER_DELAY_TICKS 拍就动手。
                // 这个延时是纯 10ms 计数，是精调"进环岛早晚"最直观的旋钮：
                // 比例线负责粗定位，延时负责往前推。
                if (rb_fall_tick > RB_ENTER_DELAY_TICKS)
                {
                    rb_state     = RB_STATE_ENTER;
                    rb_tick      = 0;
                    rb_fall_tick = 0;

                    // 接管前先把偏差记忆对齐，免得进 ENTER 那一拍算出一个巨大的变化率
                    // （虽然 ENTER 不用 D 项，但 LOOP 第一拍会接着用它）
                    rb_last_error = adc_error;
                }
            }
            else if (rb_tick > RB_HUMP_TICKS)
            {
                // 隆起迟迟不落回去（车停了、或者被拿起来了），丢掉这次机会，
                // 别一直挂在 HUMP 里把后面的冷却和识别都堵死
                rb_reason = RB_REASON_HUMP_TIMEOUT;
                rb_back_to_idle();
            }
        }break;

        //-----------------------------------------------------------------------------------------------
        // 进入：强制打角，把车头拽进圆弧
        //-----------------------------------------------------------------------------------------------
        case RB_STATE_ENTER:
        {
            if (rb_tick >= RB_TICKS_ENTER)
            {
                rb_state = RB_STATE_LOOP;
                rb_tick  = 0;
            }
        }break;

        //-----------------------------------------------------------------------------------------------
        // 绕行：保持往内侧的打角，走完设定的一段
        //-----------------------------------------------------------------------------------------------
        case RB_STATE_LOOP:
        {
            if (rb_tick >= RB_TICKS_LOOP)
            {
                rb_state = RB_STATE_EXIT;
                rb_tick  = 0;
            }
        }break;

        //-----------------------------------------------------------------------------------------------
        // 出环：方向回正，让车顺着圆环的切线走出去
        //-----------------------------------------------------------------------------------------------
        case RB_STATE_EXIT:
        {
            if (rb_tick >= RB_TICKS_EXIT)
            {
                rb_state = RB_STATE_COOL;
                rb_tick  = 0;
            }
        }break;

        //-----------------------------------------------------------------------------------------------
        // 冷却：出口那个岔口的特征和入口长得几乎一样，不隔一段时间就会把同一个环岛再认一遍，
        //       于是车在出口又拐回去，绕着环岛转圈。这一段就是专门堵这个坑的。
        //-----------------------------------------------------------------------------------------------
        case RB_STATE_COOL:
        {
            if (rb_tick >= RB_TICKS_COOL)
            {
                rb_back_to_idle();
            }
        }break;

        default:
        {
            rb_back_to_idle();
        }break;
    }
}

//-------------------------------------------------------------------------------------------------------------------
// @brief   环岛阶段的舵机接管
// @param   angle   输出，接管时把目标角度（单位：度，中值 90）写进来
// @retval  uint8   1 = 这一段由环岛接管，set_servo_pwm() 直接用 *angle，别再做 PD 了
//                  0 = 不管，set_servo_pwm() 照常做它自己的 PD
// @note    只在 ENTER / LOOP / EXIT 三段接管。WAIT / HUMP 故意不管，那会儿还得靠正常循迹把车带过去。
//          本版本只做"向左进环岛"，所以内部的 turn 直接就是"往左打多少度"，没有镜像那一层。
//          ★ 角度方向是实测出来的，跟直觉相反，务必看清：
//              servo 角度 76（偏小）= 前轮往右；servo 角度 105（偏大）= 前轮往左。
//            所以"往左打 turn 度"必须写成 90 + turn，而不是 90 - turn。
//            这个方向当初是用 RB_STEER_TEST_DEG=76 把车架起来看前轮确认的，
//            之前一直按"角度变小 = 往左"来写，结果三段打角全长反，车才会在环岛处往右冲。
//-------------------------------------------------------------------------------------------------------------------
uint8 roundabout_servo_takeover (float *angle)
{
    float turn;                                     // 往左打多少度；正 = 左
    float rate;                                     // 偏差变化率（环岛段自己的微分用）

    if ((NULL == angle) || (0 == RB_ENABLE))
    {
        return 0;
    }

    if ((RB_STATE_ENTER != rb_state) && (RB_STATE_LOOP != rb_state) && (RB_STATE_EXIT != rb_state))
    {
        return 0;                                   // 这三段以外不管舵机
    }

    // 环岛段自己的偏差记忆。为什么不用主循迹那个 last_adc_error：
    // 一是解耦（主循迹那边怎么改都不影响这里），二是主循迹在接管期间是"被同步"状态，
    // 拿它的值算 D 项等于算了个 0，微分项就废了。
    rate          = adc_error - rb_last_error;
    rb_last_error = adc_error;

    switch (rb_state)
    {
        case RB_STATE_ENTER:
        {
            // 进入段用纯固定角，一点反馈都不掺：这一段的目的就是"别管导线说什么，先拐进去"。
            // 掺了反馈反而可能因为岔口两根线的合成场把车按住不让拐，那就进不去了。
            turn = RB_DELTA_ENTER;
        }break;

        case RB_STATE_LOOP:
        {
            // 绕行段 = 环岛自己的 PD + 一个固定的左偏置。
            //
            // 符号推导（一步步写清楚，别再错）：
            //   本函数统一     angle = 90 + turn          （turn > 0 = 往左）
            //   主循迹的 PD 是 angle = 90 - kp*偏差 - kd*变化率
            //   把 PD 换成 turn：turn = -kp*偏差 - kd*变化率
            // 所以下面两项都是负号；偏置则直接加正数（角度越大越左）。
            //
            // ★ 这里用的是 RB_KP / RB_KD，不是主循迹的 kp / kd：
            //   环岛里的曲率和叠加偏置跟直道完全是两种工况，用同一套增益会互相牵制。
            turn = -RB_KP * adc_error - RB_KD * rate + RB_LOOP_BIAS;
        }break;

        default:                                    // RB_STATE_EXIT
        {
            // 出环段：RB_DELTA_EXIT 取 0 就是回中值走直线，
            // 取正数就是还带一点左打（实测出环后容易往右蹭，所以默认给了 3）。
            turn = RB_DELTA_EXIT;
        }break;
    }

    // 往左打 = 角度变大，所以是 90 + turn（实测方向，别改成减号）
    *angle = (float)SERVO_MOTOR_M + turn;

    return 1;
}

//-------------------------------------------------------------------------------------------------------------------
// @brief   环岛阶段的速度上限
// @param   无
// @retval  float   限速值（脉冲/周期）；返回 0 表示不限速
// @note    为什么单独给一道上限，而不是指望原来的弯道降速公式：
//          进岔口时外侧电感被两根线顶到 100，可另外几路反而低，差比和出来的 |偏差| 不见得大，
//          弯道降速那条公式（900 - 0.29*|偏差|）就会算出一个偏乐观的目标速度。
//          环岛里打角是固定的、没有反馈兜底，所以宁可慢一点：这里再压一道硬上限。
//          这个上限允许低于 SPEED_CURVE_MIN，speed_control.c 里是在正常限幅之后才用它的。
//
//          ★ 连 WAIT / HUMP 这两段也要限速，这一点很容易被忽略：
//          速度目标是一阶低通（每拍只走 20%），加上占空比每拍最多动 3%，
//          从 900 掉到 430 大概要十几二十拍。如果等到 ENTER 才开始刹车，
//          20 拍的进入段根本刹不完，车会带着满速拐进环岛。
//          把刹车起点提到"看到入口特征"那一拍，等于拿"内侧隆起"这整段包络当刹车距离用；
//          万一最后判定是假警报，也只是白白慢了一小会儿，车会自己加速回去。
//-------------------------------------------------------------------------------------------------------------------
float roundabout_speed_cap (void)
{
    if (0 == RB_ENABLE)
    {
        return 0.0f;
    }

    if ((RB_STATE_WAIT  != rb_state) && (RB_STATE_HUMP  != rb_state) &&
        (RB_STATE_ENTER != rb_state) && (RB_STATE_LOOP  != rb_state) &&
        (RB_STATE_EXIT  != rb_state))
    {
        return 0.0f;
    }

    return RB_SPEED_LIMIT;
}

//-------------------------------------------------------------------------------------------------------------------
// @brief   识别阶段（WAIT / HUMP）禁止舵机往右打
// @param   无
// @retval  uint8   1 = 现在处于识别阶段，舵机不许越过中值往右；0 = 不管
// @note    为什么要这一条，而不是干脆在这两个阶段接管舵机、给个固定角：
//          这两个阶段车还得靠差比和正常循迹（靠近岔口的那段路本身可能是弯的），
//          全接管成固定角就等于把循迹能力扔了。可偏偏岔口那两根线会把差比和算出
//          一个很强的"往右"偏差，车在交界处就会被猛地拽向右边冲出赛道 ——
//          这就是"到交界处突然右拐"的直接来源。
//          折中办法是只**封住往右**这一个方向：往左该打多少还是多少，往右一步都不许。
//          这样既不丢循迹，又不可能被拽出去。
//          生效范围只有 WAIT / HUMP：
//            ENTER/LOOP/EXIT 算出来的 turn 恒为正，本来就到不了右边；
//            IDLE/COOL 是纯正常循迹，管不着。
//-------------------------------------------------------------------------------------------------------------------
// @note    为什么要这一条：这两个阶段车还得靠差比和正常循迹，可岔口那两根线会把差比和
//          算成一个很强的偏差，车在交界处就可能被拽向一边。
//          折中办法是只**封住往右**这一个方向：往左该打多少还是多少。
//
//          ★★ 但这把锁现在默认是关的（RB_FORBID_RIGHT_ENABLE = 0），原因有两个：
//          ① 当初加它是为了压住"交界处往右冲"，而那个现象的真因其实是舵机方向写反，
//             已经修好了，所以它不再必要；
//          ② 它有实实在在的副作用：只要别处（比如出环之后紧跟的那条小弯）误判出一个候选，
//             车进入 WAIT 之后在这条弯里就**转不了右**，那条弯立刻走不稳。
//             这个副作用比它挡掉的问题更麻烦，所以默认让它闭嘴。
//          生效范围本来也只有 WAIT / HUMP：ENTER/LOOP/EXIT 不会算出往右，IDLE/COOL 是纯循迹。
//-------------------------------------------------------------------------------------------------------------------
uint8 roundabout_forbid_right (void)
{
    if ((0 == RB_ENABLE) || (0 == RB_FORBID_RIGHT_ENABLE))
    {
        return 0;
    }

    if ((RB_STATE_WAIT == rb_state) || (RB_STATE_HUMP == rb_state))
    {
        return 1;
    }

    return 0;
}
